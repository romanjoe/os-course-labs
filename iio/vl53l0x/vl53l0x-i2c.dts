/dts-v1/;
/plugin/;

&i2c_arm {
  status = "okay";
  #address-cells = <1>;
  #size-cells = <0>;

  /* Define the VL53L0x proximity sensor at address 0x29 */
  vl53l0x@29 {
    compatible = "st,vl53l0x";
    reg = <0x29>;
  };
};
